## Kconfig
```kconfig
menuconfig ZMK_BEHAVIOR_CLK_OR_KEY
    bool "Click-or-key behavior (Keyball44-style typing mode)"
    default y
    help
      Enable custom behavior that acts as a mouse click in mouse mode,
      but as a keyboard key in typing mode. Includes vowel auto-complete
      for Japanese romaji input.

if ZMK_BEHAVIOR_CLK_OR_KEY

config ZMK_TYPING_MODE_TIMEOUT
    int "Typing mode vowel auto-complete timeout (ms)"
    default 300
    help
      Time window in milliseconds after a click where a vowel key will
      trigger auto-insertion of the preceding consonant (J/K/L).

endif # ZMK_BEHAVIOR_CLK_OR_KEY

menuconfig ZMK_INPUT_PROCESSOR_MOUSE_ACCEL
    bool "Mouse acceleration input processor (Keyball44-style)"
    default y
    help
      Enable adaptive mouse acceleration curve and integrated
      typing mode exit on trackball movement.

menuconfig ZMK_BEHAVIOR_BT_TOGGLE_01
    bool "BT profile toggle (0 <-> 1)"
    default y
    help
      Flip between BT profiles 0 and 1 on each activation. Handy for
      users who only rotate between two Bluetooth hosts.

menuconfig ZMK_INPUT_PROCESSOR_SCROLL_MODE
    bool "Scroll-mode input processor (Keyball44 drag-scroll port)"
    default y
    help
      Convert trackball REL_X/REL_Y events into REL_HWHEEL/REL_WHEEL
      while the global scroll mode is active. Works with clk_or_key's
      scroll trigger (param2 = 0xFF) and fixed-scroll lock.
```

## dts/bindings/behaviors/zmk,behavior-bt-toggle-01.yaml
```yaml
description: |
  Toggle the active BT profile between 0 and 1. Each activation flips
  to whichever of {0, 1} is not currently active (any other profile
  index is treated as "not 0" and will move to 0).

compatible: "zmk,behavior-bt-toggle-01"

include: zero_param.yaml
```

## dts/bindings/behaviors/zmk,behavior-clk-or-key.yaml
```yaml
description: |
  Click-or-key behavior. Acts as a mouse button in mouse mode, but as a
  keyboard key in typing mode. Provides Keyball44-style typing mode with
  automatic switching based on trackball movement.

compatible: "zmk,behavior-clk-or-key"

include: two_param.yaml

properties:
  "#binding-cells":
    const: 2
```

## dts/bindings/behaviors/zmk,behavior-os-aware.yaml
```yaml
description: |
  OS-aware key press: param1 fires when BT profile 0 is active (Mac),
  param2 fires for any other profile. Use to swap LGUI/LCTRL or
  Cmd-Shift-[ vs Ctrl-Tab style shortcuts per host.

compatible: "zmk,behavior-os-aware"

include: two_param.yaml
```

## dts/bindings/behaviors/zmk,behavior-vowel-auto.yaml
```yaml
description: |
  Vowel key with Keyball-style autocomplete. On press, if a recent J/K/L
  click recorded a consonant within the typing-mode timeout, the
  consonant is sent via a direct HID tap BEFORE the vowel keycode event
  is raised. Mirrors QMK's tap_code16 + return true flow.

compatible: "zmk,behavior-vowel-auto"

include: one_param.yaml
```

## dts/bindings/input_processors/zmk,input-processor-mouse-accel.yaml
```yaml
description: |
  Mouse acceleration input processor with Keyball-style adaptive curve.
  Applies a nonlinear speed multiplier to REL_X/REL_Y events and exits
  typing mode when the movement magnitude exceeds a threshold.

compatible: "zmk,input-processor-mouse-accel"

include: ip_zero_param.yaml
```

## dts/bindings/input_processors/zmk,input-processor-scroll-mode.yaml
```yaml
description: |
  Scroll-mode input processor. Converts REL_X/REL_Y into REL_HWHEEL/REL_WHEEL
  while the global scroll mode (g_is_scrolling or g_is_fixed_scroll) is active.
  Uses an internal accumulator for tick quantization.

compatible: "zmk,input-processor-scroll-mode"

include: ip_zero_param.yaml
```
