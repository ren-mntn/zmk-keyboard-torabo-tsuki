#include "torabo_tsuki.dtsi"
#include <input/processors.dtsi>
#include <dt-bindings/zmk/input_transform.h>

&size_s_transform {
    col-offset = <7>;
};

&size_m_transform {
    col-offset = <7>;
};

&size_l_transform {
    col-offset = <7>;
};

&trackball_listener {
    /* Order matters: scroll_mode converts X/Y to WHEEL/HWHEEL when active,
     * so mouse_accel (X/Y only) then no-ops on wheel events. */
    input-processors = <&scroll_mode>, <&mouse_accel>;
};